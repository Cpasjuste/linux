// SPDX-License-Identifier: (GPL-2.0 OR MIT)
/*
 * Copyright (C) 2024 Thomas Bonnefille <thomas.bonnefille@bootlin.com>
 */

/dts-v1/;

#include "sg2002.dtsi"

/ {
	model = "Lichee RV Nano";
	compatible = "sipeed,licheerv-nano", "sophgo,sg2002";

	aliases {
		serial0 = &uart0;
	};

	chosen {
		stdout-path = "serial0:115200n8";
	};
};


&uart0 {
	status = "okay";
};

pwm_clk: pwm-clk{
	compatible = "fixed-clock";
	clock-frequency = "100000000";
	#clock-cells = <0>;
}

pwm0: pwm@3060000 {
	compatible = "cvitek,cvi-pwm";
	reg = <0x0 0x3060000 0x0 0x1000>;
	clocks = <&pwm_clk>;
	#pwm-cells = <4>;
};
