## Documentation/devicetree/bindings/iio/adc/sophgo,sophgo-adc.yaml
```yaml
# SPDX-License-Identifier: (GPL-2.0-only OR BSD-2-Clause)
%YAML 1.2
---
$id: http://devicetree.org/schemas/iio/adc/adi,ad7944.yaml#
$schema: http://devicetree.org/meta-schemas/core.yaml#

title: Sophgo 3 channels Successive Approximation Analog to Digital Converters

maintainers:
  - Thomas Bonnefille <thomas.bonnefille@bootlin.com>

description: |
  Datasheet at: https://github.com/sophgo/sophgo-doc/releases

$ref: /schemas/spi/spi-peripheral-props.yaml#

properties:
  compatible:
    enum:
      - sophgo,sophgo-saradc

  reg:
    maxItems: 1

  interrupts:
    maxItems: 1

  clocks:
    description: SARADC source clock
    maxItems: 1

  clock-names:
    const: saradc_clk

required:
  - compatible
  - reg
  - interrupts
  - clocks
  - clock-names

examples:
  - |
		adc@30f0000 {
			compatible = "sophgo,sophgo-saradc";
			clocks = <&clk CLK_SARADC>;
			clock-names = "saradc_clk";
			interrupts = <100 IRQ_TYPE_LEVEL_HIGH>;
			reg = <0x030F0000 0x1000>;
			status = "okay";
		};
```

## Documentation/devicetree/bindings/pwm/pwm-sophgo.yaml
```yaml
# SPDX-License-Identifier: (GPL-2.0-only OR BSD-2-Clause)
%YAML 1.2
---
$id: http://devicetree.org/schemas/pwm/pwm-sophgo.yaml#
$schema: http://devicetree.org/meta-schemas/core.yaml#

title: Sophgo PWM controller

maintainers:
  - Thomas Bonnefille <thomas.bonnefille@outlook.com>

allOf:
  - $ref: pwm.yaml#

properties:
  compatible:
    items:
      - const: sophgo,sophgo-pwm

  reg:
    maxItems: 1

  clocks:
    maxItems: 1

  "#pwm-cells":
    const: 4

required:
  - compatible
  - reg
  - clocks

additionalProperties: false

examples:
  - |
    pwm0: pwm@3060000 {
      compatible = "sophgo,sophgo-pwm";
      reg = <0x0 0x3060000 0x0 0x1000>;
      clocks = <&clk CV181X_CLK_PWM>;
      #pwm-cells = <4>;
    };
```
